## integrations/esp-firmware/CAM/sdkconfig.defaults
```kconfig
CONFIG_IDF_TARGET="esp32p4"
CONFIG_ESPTOOLPY_FLASHSIZE_16MB=y
CONFIG_ESPTOOLPY_FLASHMODE_DIO=y
CONFIG_ESPTOOLPY_FLASHFREQ_80M=y
CONFIG_ESP32P4_REV_MIN_100=y
CONFIG_SPIRAM=y
CONFIG_SPIRAM_SPEED_80M=y
CONFIG_SPIRAM_USE_MALLOC=y
CONFIG_SPIRAM_MEMTEST=n
CONFIG_PARTITION_TABLE_CUSTOM=y
CONFIG_PARTITION_TABLE_CUSTOM_FILENAME="partitions.csv"
CONFIG_CAMERA_OV5647=y
CONFIG_CAMERA_OV5647_AUTO_DETECT=y
CONFIG_CAMERA_OV5647_MIPI_RAW8_800x640_50FPS=y
CONFIG_CAMERA_OV5647_MIPI_IF_FORMAT_INDEX_DAFAULT=1
CONFIG_ESP_VIDEO_ENABLE_MIPI_CSI_VIDEO_DEVICE=y
CONFIG_ESP_VIDEO_ENABLE_DVP_VIDEO_DEVICE=n
CONFIG_ESP_VIDEO_ENABLE_HW_H264_VIDEO_DEVICE=n
CONFIG_ESP_VIDEO_ENABLE_HW_JPEG_VIDEO_DEVICE=n
CONFIG_FREERTOS_HZ=1000
CONFIG_ESP_MAIN_TASK_STACK_SIZE=6144
CONFIG_ESP_TASK_WDT_TIMEOUT_S=10
CONFIG_LWIP_SO_RCVBUF=y
CONFIG_LWIP_TCP_SND_BUF_DEFAULT=32768
CONFIG_LWIP_TCP_WND_DEFAULT=16384
CONFIG_LWIP_TCP_RECVMBOX_SIZE=16
CONFIG_LWIP_UDP_RECVMBOX_SIZE=24
CONFIG_LWIP_TCPIP_RECVMBOX_SIZE=64
CONFIG_ESP_HTTP_CLIENT_ENABLE_CUSTOM_TRANSPORT=y
CONFIG_ESP_HOSTED_ENABLED=y
CONFIG_ESP_HOSTED_P4_DEV_BOARD_NONE=y
# CONFIG_ESP_HOSTED_P4_DEV_BOARD_FUNC_BOARD is not set
CONFIG_ESP_HOSTED_PRIV_SDIO_OPTION=y
CONFIG_ESP_HOSTED_PRIV_SPI_HD_OPTION=y
# CONFIG_ESP_HOSTED_SPI_HOST_INTERFACE is not set
CONFIG_ESP_HOSTED_SDIO_HOST_INTERFACE=y
# CONFIG_ESP_HOSTED_SPI_HD_HOST_INTERFACE is not set
# CONFIG_ESP_HOSTED_UART_HOST_INTERFACE is not set
CONFIG_ESP_HOSTED_IDF_SLAVE_TARGET="esp32c6"
CONFIG_ESP_HOSTED_SDIO_RESET_ACTIVE_HIGH=y
# CONFIG_ESP_HOSTED_SDIO_RESET_ACTIVE_LOW is not set
# CONFIG_ESP_HOSTED_SDIO_OPTIMIZATION_RX_NONE is not set
# CONFIG_ESP_HOSTED_SDIO_OPTIMIZATION_RX_MAX_SIZE is not set
CONFIG_ESP_HOSTED_SDIO_OPTIMIZATION_RX_STREAMING_MODE=y
# CONFIG_ESP_HOSTED_SDIO_SLOT_0 is not set
CONFIG_ESP_HOSTED_SDIO_SLOT_1=y
CONFIG_ESP_HOSTED_SDIO_SLOT=1
CONFIG_ESP_HOSTED_SD_PWR_CTRL_LDO_INTERNAL_IO=y
CONFIG_ESP_HOSTED_SD_PWR_CTRL_LDO_IO_ID=4
CONFIG_ESP_HOSTED_SDIO_4_BIT_BUS=y
# CONFIG_ESP_HOSTED_SDIO_1_BIT_BUS is not set
CONFIG_ESP_HOSTED_SDIO_BUS_WIDTH=4
CONFIG_ESP_HOSTED_SDIO_CLOCK_FREQ_KHZ=40000
CONFIG_ESP_HOSTED_SDIO_CMD_GPIO_RANGE_MIN=0
CONFIG_ESP_HOSTED_SDIO_CMD_GPIO_RANGE_MAX=100
CONFIG_ESP_HOSTED_SDIO_CLK_GPIO_RANGE_MIN=0
CONFIG_ESP_HOSTED_SDIO_CLK_GPIO_RANGE_MAX=100
CONFIG_ESP_HOSTED_SDIO_D0_GPIO_RANGE_MIN=0
CONFIG_ESP_HOSTED_SDIO_D0_GPIO_RANGE_MAX=100
CONFIG_ESP_HOSTED_SDIO_D1_GPIO_RANGE_MIN=0
CONFIG_ESP_HOSTED_SDIO_D1_GPIO_RANGE_MAX=100
CONFIG_ESP_HOSTED_SDIO_D2_GPIO_RANGE_MIN=0
CONFIG_ESP_HOSTED_SDIO_D2_GPIO_RANGE_MAX=100
CONFIG_ESP_HOSTED_SDIO_D3_GPIO_RANGE_MIN=0
CONFIG_ESP_HOSTED_SDIO_D3_GPIO_RANGE_MAX=100
CONFIG_ESP_HOSTED_SDIO_RESET_SLAVE_GPIO_MIN=0
CONFIG_ESP_HOSTED_SDIO_RESET_SLAVE_GPIO_MAX=100
CONFIG_ESP_HOSTED_PRIV_SDIO_PIN_CMD_SLOT_1=47
CONFIG_ESP_HOSTED_PRIV_SDIO_PIN_CLK_SLOT_1=48
CONFIG_ESP_HOSTED_PRIV_SDIO_PIN_D0_SLOT_1=49
CONFIG_ESP_HOSTED_PRIV_SDIO_PIN_D1_4BIT_BUS_SLOT_1=50
CONFIG_ESP_HOSTED_PRIV_SDIO_PIN_D2_4BIT_BUS_SLOT_1=51
CONFIG_ESP_HOSTED_PRIV_SDIO_PIN_D3_4BIT_BUS_SLOT_1=52
CONFIG_ESP_HOSTED_SDIO_GPIO_RESET_SLAVE=54
CONFIG_ESP_HOSTED_SDIO_PIN_CMD=47
CONFIG_ESP_HOSTED_SDIO_PIN_CLK=48
CONFIG_ESP_HOSTED_SDIO_PIN_D0=49
CONFIG_ESP_HOSTED_SDIO_PRIV_PIN_D1_4BIT_BUS=50
CONFIG_ESP_HOSTED_SDIO_PIN_D2=51
CONFIG_ESP_HOSTED_SDIO_PIN_D3=52
CONFIG_ESP_HOSTED_SDIO_PIN_D1=50
CONFIG_ESP_HOSTED_SDIO_TX_Q_SIZE=20
CONFIG_ESP_HOSTED_SDIO_RX_Q_SIZE=20
# CONFIG_ESP_HOSTED_SDIO_CHECKSUM is not set
CONFIG_ESP_HOSTED_SLAVE_RESET_ON_EVERY_HOST_BOOTUP=y
# CONFIG_ESP_HOSTED_SLAVE_RESET_ONLY_IF_NECESSARY is not set
CONFIG_ESP_HOSTED_GPIO_SLAVE_RESET_SLAVE=54
CONFIG_ESP_HOSTED_RPC_TASK_STACK=4096
CONFIG_ESP_HOSTED_DFLT_TASK_STACK=3072
# CONFIG_ESP_HOSTED_ENABLE_ITWT is not set
CONFIG_ESP_HOSTED_USE_MEMPOOL=y
CONFIG_ESP_HOSTED_MAX_SIMULTANEOUS_SYNC_RPC_REQUESTS=5
CONFIG_ESP_HOSTED_MAX_SIMULTANEOUS_ASYNC_RPC_REQUESTS=5
CONFIG_ESP_HOSTED_CLI_ENABLED=y
# CONFIG_ESP_HOSTED_CLI_NEW_INSTANCE is not set
# CONFIG_ESP_HOSTED_RAW_THROUGHPUT_TRANSPORT is not set
# CONFIG_ESP_HOSTED_PKT_STATS is not set
CONFIG_ESP_HOSTED_HOST_TO_ESP_WIFI_DATA_THROTTLE=y
CONFIG_ESP_HOSTED_PRIV_WIFI_TX_SDIO_HIGH_THRESHOLD=80
CONFIG_ESP_HOSTED_TO_WIFI_DATA_THROTTLE_HIGH_THRESHOLD=80
CONFIG_ESP_HOSTED_TO_WIFI_DATA_THROTTLE_LOW_THRESHOLD=60
# CONFIG_ESP_HOSTED_DECODE_WIFI_RESERVED_FIELD is not set
# CONFIG_ESP_HOSTED_NETWORK_SPLIT_ENABLED is not set
# CONFIG_ESP_HOSTED_HOST_POWER_SAVE_ENABLED is not set
CONFIG_ESP_HOSTED_HOST_DEEP_SLEEP_ALLOWED=y
CONFIG_ESP_HOSTED_HOST_WAKEUP_GPIO=6
CONFIG_ESP_HOSTED_HOST_WAKEUP_GPIO_LEVEL=1
CONFIG_ESP_WIFI_REMOTE_ENABLED=y
# CONFIG_SLAVE_IDF_TARGET_ESP32 is not set
# CONFIG_SLAVE_IDF_TARGET_ESP32S2 is not set
# CONFIG_SLAVE_IDF_TARGET_ESP32C3 is not set
# CONFIG_SLAVE_IDF_TARGET_ESP32S3 is not set
# CONFIG_SLAVE_IDF_TARGET_ESP32C2 is not set
CONFIG_SLAVE_IDF_TARGET_ESP32C6=y
# CONFIG_SLAVE_IDF_TARGET_ESP32C5 is not set
# CONFIG_SLAVE_IDF_TARGET_ESP32C61 is not set
CONFIG_SLAVE_IDF_TARGET_ARCH_RISCV=y
CONFIG_ESP_WIFI_REMOTE_LIBRARY_HOSTED=y
# CONFIG_ESP_WIFI_REMOTE_LIBRARY_EPPP is not set
# CONFIG_ESP_WIFI_REMOTE_LIBRARY_CUSTOM is not set
CONFIG_ESP_WIFI_REMOTE_EAP_ENABLED=y
CONFIG_ESP_SDIO_HOST_INTERFACE=y
CONFIG_ESP_SDIO_OPTIMIZATION_RX_STREAMING_MODE=y
CONFIG_ESP_SDIO_4_BIT_BUS=y
CONFIG_ESP_SDIO_BUS_WIDTH=4
CONFIG_ESP_SDIO_CLOCK_FREQ_KHZ=40000
CONFIG_ESP_SDIO_GPIO_RESET_SLAVE=54
CONFIG_ESP_SDIO_PIN_CMD=47
CONFIG_ESP_SDIO_PIN_CLK=48
CONFIG_ESP_SDIO_PIN_D0=49
CONFIG_ESP_SDIO_PIN_D2=51
CONFIG_ESP_SDIO_PIN_D3=52
CONFIG_ESP_SDIO_PIN_D1=50
CONFIG_ESP_SDIO_TX_Q_SIZE=20
CONFIG_ESP_SDIO_RX_Q_SIZE=20
```

## integrations/esp-firmware/Repeater/sdkconfig.defaults
```kconfig
CONFIG_IDF_TARGET="esp32"
CONFIG_ESPTOOLPY_FLASHSIZE_4MB=y
CONFIG_ESPTOOLPY_FLASHMODE_DIO=y
CONFIG_LWIP_IP_FORWARD=y
CONFIG_LWIP_IPV4_NAPT=y
CONFIG_LWIP_L2_TO_L3_COPY=y
CONFIG_FREERTOS_HZ=1000
CONFIG_PARTITION_TABLE_SINGLE_APP_LARGE=y
CONFIG_ESP_WIFI_SOFTAP_SUPPORT=y
CONFIG_ESP_DEFAULT_CPU_FREQ_MHZ_240=y
CONFIG_LWIP_UDP_RECVMBOX_SIZE=24
CONFIG_LWIP_TCPIP_RECVMBOX_SIZE=64
CONFIG_ESP_WIFI_DYNAMIC_TX_BUFFER_NUM=48
CONFIG_LWIP_TCP_SND_BUF_DEFAULT=32768
CONFIG_LWIP_TCP_WND_DEFAULT=32768
CONFIG_LWIP_TCP_RECVMBOX_SIZE=32
```
